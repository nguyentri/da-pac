# DA14586 register map
Vendor: Dialog; Series: DA1458x; File version: 1.2
Ultra-Low power Bleutooth 5.0 SoC with audio interface and 2 Mbit flash from Dialog Semiconductor
CPU: CM0 r1p0, little endian, MPU, FPU, 3 interrupt priority bits
Registers are 16-bit, read-write, reset 0x0 unless marked. A register's access mark holds for its fields unless they carry their own. Offsets are from the block's base; lines under a group give offsets from that group; [hi:lo] are bit positions; {n}, {i} and the like mark numbered series; 'fields as' and 'values as' point back to an identical list; <NAME> marks a mode.

## Memory map
0x40000000 ble580_gr01 size 0x208 — ble580_gr01 registers
0x40008000 otpc580_gr01 size 0x20 — otpc580_gr01 registers
0x40008400 ambacore580_patch_gr00 size 0x50 — ambacore580_patch_gr00 registers
0x50000000 crg580_nl01 size 0x40 — crg580_nl01 registers
0x50000080 crg580_dcdc_nl01 size 0xC — crg580_dcdc_nl01 registers
0x50000100 wkup580_nl01 size 0x1A — wkup580_nl01 registers
0x50000200 quadec580_gr01 size 0xC — quadec580_gr01 registers
0x50001000 UART1 size 0xFE — UART1 registers
0x50001100 UART2 size 0xFE — UART2 registers
0x50001200 spi443_nl00 size 0xA — spi443_nl00 registers
0x50001300 i2c580_nl00 size 0xA2 — i2c580_nl00 registers
0x50001400 kbrd580_nl01 size 0x18 — kbrd580_nl01 registers
0x50001500 adc580_bif_nl01 size 0x10 — adc580_bif_nl01 registers
0x50001600 anamisc580_nl01 size 0x8 — anamisc580_nl01 registers
0x50002000 r_rfcu580_nl01 size 0xC72 — r_rfcu580_nl01 registers
0x50003000 gpio580_ports_nl01 size 0x100 — gpio580_ports_nl01 registers
0x50003100 riscutil580_wdog_nl00 size 0x4 — riscutil580_wdog_nl00 registers
0x50003200 CHIP_VERSION size 0xC — CHIP_VERSION registers
0x50003300 riscutil580_gpreg_nl01 size 0xA — riscutil580_gpreg_nl01 registers
0x50003400 tmr580_nl01 size 0x12 — tmr580_nl01 registers
0x50003500 rfpt580_gr01 size 0x8 — rfpt580_gr01 registers
0xE000E010 SysTick size 0x11 — Cortex M0 SysTick registers
0xE000E100 NVIC size 0x321 — Cortex M0 NVIC registers
0xE000ED00 SCB size 0x29 — Cortex M0 SCB registers

## Interrupts
0 BLE_WAKEUP_LP (wkup580_nl01) — Wake-up from Low Power (Extended Sleep) interrupt from BLE
1 BLE_GEN (wkup580_nl01) — BLE Interrupt from various BLE sources.
2 UART (wkup580_nl01) — UART interrupt
3 UART2 (wkup580_nl01) — UART2 interrupt
4 I2C (wkup580_nl01) — I2C interrupt
5 SPI (wkup580_nl01) — SPI interrupt
6 ADC (wkup580_nl01) — Analog-Digital Converter interrupt.
7 KEYBRD (wkup580_nl01) — Keyboard interrupt.
8 BLE_RF_DIAG (wkup580_nl01) — Baseband or Radio Diagnostics Interrupt
9 RF_CAL (wkup580_nl01) — RF Calibration Interrupt
10 GPIO0 (wkup580_nl01) — GPIO0 interrupt through debounce
11 GPIO1 (wkup580_nl01) — GPIO1 interrupt through debounce
12 GPIO2 (wkup580_nl01) — GPIO2 interrupt through debounce
13 GPIO3 (wkup580_nl01) — GPIO3 interrupt through debounce
14 GPIO4 (wkup580_nl01) — GPIO4 interrupt through debounce
15 SWTIM (wkup580_nl01) — Software Timer interrupt
16 WKUP_QUADEC (wkup580_nl01) — Combines the Wake up Capture Timer interrupt, the GPIO interrupt and the QuadDecoder interrupt
17 PCM (wkup580_nl01) — PCM interrupt
18 SRC_IN (wkup580_nl01) — Sample rate converter input interrupt
19 SRC_OUT (wkup580_nl01) — Sample rate converter output interrupt
20 DMA (wkup580_nl01) — DMA interrupt

## Licence text in the file
Copyright (C) 2018 Dialog Semiconductor. This computer program includes Confidential, Proprietary Information of Dialog Semiconductor. All Rights Reserved. . Dialog GmbH (DLG) is supplying this software for use with Cortex-M processor based microcontroller, but can be equally used for other suitable processor architectures. This file can be freely distributed. Modifications to this file shall be clearly marked. . THIS SOFTWARE IS PROVIDED AS IS . NO WARRANTIES, WHETHER EXPRESS, IMPLIED. OR STATUTORY, INCLUDING, BUT NOT LIMITED TO, IMPLIED WARRANTIES OF. MERCHANTABILITY AND FITNESS FOR A PARTICULAR PURPOSE APPLY TO THIS SOFTWARE. ARM SHALL NOT, IN ANY CIRCUMSTANCES, BE LIABLE FOR SPECIAL, INCIDENTAL, OR. CONSEQUENTIAL DAMAGES, FOR ANY REASON WHATSOEVER.
